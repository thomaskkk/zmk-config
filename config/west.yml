## config/west.yml
```yaml
manifest:
  remotes:
    - name: thomaskkk
      url-base: https://github.com/thomaskkk
  projects:
    - name: zmk
      remote: thomaskkk
      revision: main
      import: app/west.yml
  self:
    path: config
```
